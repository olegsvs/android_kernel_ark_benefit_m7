/*
 * Generated by MTK SP DrvGen Version 03.13.6 for MT6753. Copyright MediaTek Inc. (C) 2013.
 * Thu Jun 04 13:39:08 2015
 * Do Not Modify the File.
 */

/**********************************************
 *Keypad DTSI File
********************************************/

&keypad {	
	KPD@ {
		compatible = "mediatek, kpd";
		kpd-key-debounce = <1024>;
		kpd-sw-pwrkey = <116>;
		kpd-hw-pwrkey = <8>;
		kpd-use-extend-type = <0>;
		/*HW Keycode [0~71] -> Linux Keycode*/
		kpd-hw-init-map = <528 114 0 0 0 0 0 0 0 0 115 0 0 0 0 0 0 0 0 0 0 0 0 0 0 0 0 0 0 0 0 0 0 0 0 0 0 0 0 0 0 0 0 0 0 0 0 0 0 0 0 0 0 0 0 0 0 0 0 0 0 0 0 0 0 0 0 0 0 0 0 0 >;
		kpd-pwrkey-eint-gpio = <0>;
		kpd-pwkey-gpio-din  = <0>;
		kpd-hw-dl-key0 = <10>;
		kpd-hw-dl-key1 = <1>;
		kpd-hw-dl-key2 = <8>;
		/*****************************************************************/
		/*******************Uboot Customation***************************/
		/*****************************************************************/
		kpd-hw-recovery-key = <10>;
		kpd-hw-factory-key  = <1>;
	};
};
